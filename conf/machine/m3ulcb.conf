## conf/machine/m3ulcb.conf
```bitbake
#@TYPE: Machine
#@NAME: M3ULCB
#@DESCRIPTION: Machine configuration for the RCAR3 M3ULCB

# CPU core tuning
require conf/machine/include/arm/arch-armv8.inc

# Preferences
PREFERRED_VERSION_u-boot ?= "git"
PREFERRED_PROVIDER_u-boot ?= "u-boot"
PREFERRED_PROVIDER_virtual/kernel ?= "linux-mainline"
UBOOT_MACHINE = "r8a7796_ulcb_config"
UBOOT_SUFFIX = "img"
SPL_BINARY = "SPL"

# Build kernel 4.15-rc1
KBRANCH = "master"
# v4.15-rc1 tag
SRCREV_linux-mainline = "4fbd8d194f06c8a3fd2af1ce560ddb31f7ec8323"
LINUX_VERSION = "4.15-rc1"

SOC_FAMILY = "rcar-gen3:"

include conf/machine/include/soc-family.inc

IMAGE_FSTYPES ?= "tar.bz2"

KERNEL_DEVICETREE = " \
    renesas/r8a7796-m3ulcb.dtb \
    "
KERNEL_IMAGETYPE = "Image"

MACHINE_FEATURES = "alsa bluetooth phone serial usbhost wifi"

MACHINE_EXTRA_RRECOMMENDS += " kernel-modules kernel-devicetree u-boot"

SERIAL_CONSOLE = "115200 ttySC0"
```
